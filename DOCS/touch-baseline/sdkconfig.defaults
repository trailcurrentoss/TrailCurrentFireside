## components/bsp_illuminate/Kconfig.projbuild
```kconfig
menu "bsp_illuminate — display pipeline"

    config DISPLAY_LVGL_AVOID_TEAR
        bool "Use panel frame buffers directly (tear-free)"
        default y
        help
            When enabled, esp_lvgl_port sets LVGL's buf1/buf2 to the two DPI
            frame buffers owned by the MIPI-DSI panel and skips its own PSRAM
            buffer allocation. Requires num_fbs = 2 in esp_lcd_dpi_panel_config_t.
            Eliminates the per-frame PSRAM->PSRAM memcpy that the fallback
            (separate LVGL buffers + copy into a single DPI FB) performs, and
            removes visible tearing on scroll/animation. Should be combined
            with either DIRECT_MODE (recommended) or FULL_REFRESH.

    config DISPLAY_LVGL_DIRECT_MODE
        bool "LVGL direct mode (dirty-region sync)"
        default y
        help
            LVGL draws into whichever panel FB is currently the back buffer, at
            absolute screen coordinates, and copies only the union of the
            current-frame + prior-frame dirty areas to the other FB after each
            swap. Cheaper per frame than full refresh. Incompatible with LVGL
            sw_rotate (rotation must be identity or performed by the panel).

    config DISPLAY_LVGL_FULL_REFRESH
        bool "LVGL full-refresh mode"
        default n
        help
            LVGL always redraws the entire screen into the back FB. Wastes
            CPU/PPA on unchanged areas but sidesteps dirty-region sync bugs.
            Kept for A/B comparison against direct mode. Mutually exclusive
            with DIRECT_MODE at runtime (esp_lvgl_port picks direct_mode first
            if both are set).

endmenu
```

## components/peregrine_voice/Kconfig
```kconfig
menu "Peregrine Voice Terminal"

config PEREGRINE_URL
    string "Peregrine base URL"
    default "http://peregrine.local:8081"
    help
        Base URL of the Peregrine chat service. The client POSTs the
        captured WAV to ${URL}/api/voice.  No trailing slash.

config PEREGRINE_VOICE_TOKEN
    string "Peregrine bearer token"
    default ""
    help
        Bearer token sent in the Authorization header. If empty, the
        Peregrine voice request is skipped (mic capture still runs so
        the local audio path can be exercised). This value is baked
        into firmware — for production, override at NVS at runtime.

config PEREGRINE_HTTP_TIMEOUT_MS
    int "HTTP total timeout (ms)"
    default 60000
    help
        Kills the request if Peregrine hasn't finished streaming the
        reply within this window. Long enough for a multi-sentence
        Piper reply (typically ~5-8 s of playback) plus LLM latency.

endmenu
```

## main/Kconfig.projbuild
```kconfig
menu "Fireside"

    config FIRESIDE_TOUCH_DIAG
        bool "Enable touch/LVGL diagnostic probes"
        default n
        help
            Installs the perf.c diagnostic probes: LVGL task stall
            watchdog (logs when the LVGL task blocks >200 ms), raw touch
            DOWN/UP transition sampler, and keyboard VALUE_CHANGED event
            logging. Diagnosis builds only — the probes cost CPU and log
            bandwidth on the LVGL task and must stay off in normal
            builds.

endmenu
```
